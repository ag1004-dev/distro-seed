## image/set-hostname/Kconfig
```kconfig
config DS_HOSTNAME
	string "Set hostname value"
	help
	  Set the hostname for the target system.  If it is left blank,
	  it defaults to ${DISTRO}-${RELEASE}-${TARGET_ARCH}
```

## image/set-locales/Kconfig
```kconfig
config LOCALES
	default "en_US.UTF-8"
	string "Set Locale value"
	help
	  Set the locale on the image. See "dpkg-reconfigure locales" for the 
	  full list

config PURGE_LOCALES
	bool "Purge unused locales"
	help
	  Purges unused locales, all but what is specified in CONFIG_SET_LOCALE_VALUE
```

## image/set-log-size/Kconfig
```kconfig
config DS_JOURNAL_SIZE_OVERRIDE
	bool "journalctl log size override"
	help
	  Override the defaults for how many logs are saved

config DS_JOURNAL_DISABLE_LOGS
	depends on DS_JOURNAL_SIZE_OVERRIDE
	bool "Disable all logs"
	help
	  Disable logging

config DS_JOURNAL_SIZE_VALUE
	depends on DS_JOURNAL_SIZE_OVERRIDE && !DS_JOURNAL_DISABLE_LOGS
	default "200M"
	string "Set Journal size limit"
	help
		Sets the journalctl --vacuum-size= value.
```

## image/set-ntp/Kconfig
```kconfig
config DS_USE_NTPSERVER
	default y
	bool "Enable NTP"
	help
	  Enable NTP by default using timesyncd

config DS_USE_NTPSERVER_PROVIDER
	string "NTP Server"
	depends on DS_USE_NTPSERVER
	default "time.cloudflare.com"
	help
	  NTP server to use with timesyncd
```

## image/set-timezone/Kconfig
```kconfig
config TIMEZONE_OVERRIDE
	default y
	bool "Timezone Override"
	help
	  Override the timezone

config TIMEZONE_VALUE
	depends on TIMEZONE_OVERRIDE
	default "America/Phoenix"
	string "Set System Timezone"
	help
	  Set the timezone on the image.  See timezone from /usr/share/zoneinfo
	  for the list of all timezones.
```

## image/ssh-regen-keys/Kconfig
```kconfig
config REGENERATE_SSH_KEYS
        default y
	bool "Regenerate SSH keys on first boot"
	help
	  Regenerate SSH keys during first boot. Otherwise if ssh is included
          in the image, all images would have the same keys. You should say
          'y' here unless ssh is not included in the image.
```

## image/update-command-not-found/Kconfig
```kconfig
config REGENERATE_COMMAND_NOT_FOUND
        default y
	bool "Update command-not-found database"
	help
	  When an unknown command is run in the default bash shell, the
          command-not-found package can specify which package is needed
          to run a command. If this is not selected some space is saved on the
          image, but this is useful for development.
```

## image_configuration/Kconfig
```kconfig
menu "Image Configuration"

comment "Required Settings"
source "image_configuration/set-locales/Kconfig"
source "image_configuration/set-hostname/Kconfig"
source "image_configuration/set-timezone/Kconfig"
source "image_configuration/set-fstab/Kconfig"

comment "Optional Settings"
source "image_configuration/ssh-regen-keys/Kconfig"
source "image_configuration/update-command-not-found/Kconfig"
source "image_configuration/set-log-size/Kconfig"
source "image_configuration/purge-man-pages/Kconfig"
source "image_configuration/nfsroot-helper/Kconfig"
source "image_configuration/set-ntp/Kconfig"

endmenu
```

## image_configuration/set-locales/Kconfig
```kconfig
config DS_LOCALES
	default "en_US.UTF-8"
	string "Set Locale value"
	help
	  Set the locale on the image. See "dpkg-reconfigure locales" for the 
	  full list

config DS_PURGE_LOCALES
	bool "Purge unused locales"
	help
	  Purges unused locales, all but what is specified in DS_LOCALES
```

## kernel/Kconfig
```kconfig
menu "Kernel"

choice
        prompt "Kernel version"
        default KERNEL_PROVIDER_GIT

config KERNEL_PROVIDER_GIT
        bool "Kernel source provider is custom git repository"
        help
          This option allows distro-seed to grab the kernel sources from git

endchoice

if KERNEL_PROVIDER_GIT

config KERNEL_PROVIDER_GIT_URL
        string "URL of git repository"
        help
          Specify git repo to fetch kernel

config KERNEL_PROVIDER_GIT_VERSION
        string "Kernel GIT srcrev"
        help
          Specify tag or branch to checkout before building
endif

config KERNEL_DEFCONFIG
        string "Git defconfig"
        help
          Specify kernel defconfig to use

config KERNEL_INSTALL_DEVICETREE_FILESYSTEM
        string "Names of device tree targets to install on the target"
        help   
          Device tree names to install on the target, eg:
          foo
          would build foo.dtb and install it to /boot/foo.dtb

config KERNEL_INSTALL_ZIMAGE_FILESYSTEM
        bool "Install zImage to the target filesystem in /boot/"

config KERNEL_INSTALL_UIMAGE_FILESYSTEM
        bool "Install legacy uImage to the target filesystem in /boot/"

config KERNEL_INSTALL_UIMAGE_LOADADDR
        hex "uImage Loadaddr"
        depends on KERNEL_INSTALL_UIMAGE_FILESYSTEM
        help
          Specify the load address for the kernel. This is required for the
          uImage kernel format.  This is usually found in the target's u-boot
          from:  "env print loadaddr" or "env print kernel_addr_r"

endmenu
```

## packages/Kconfig
```kconfig
menu "Packages"

source "packages/distroboot-scripts/Kconfig"
source "packages/legacy-bootscript/Kconfig"
source "packages/resize/Kconfig"

menu "Hardware Specific Packages"
source "packages/ts4900-utils/Kconfig"
source "packages/ts4900-fpga/Kconfig"
source "packages/wilc-firmware/Kconfig"
endmenu

endmenu
```

## packages/distroboot-scripts/Kconfig
```kconfig
config PACKAGE_DISTROBOOT_SCRIPTS
        bool "Install distroboot compatible /boot/boot.scr script"
        help
          For newer u-boots with distroboot a valid /boot/boot.scr script
          is needed to boot the system.

if PACKAGE_DISTROBOOT_SCRIPTS
config PACKAGE_DISTROBOOT_SCRIPTS_INSTALL_SOURCE
        bool "Install distroboot script source file to /boot/boot.source"
        help
          Install the distroboot script source to the image. This can be used to
          change the script simpler on the unit itself
endif
```

## packages/legacy-bootscript/Kconfig
```kconfig
config DS_PACKAGE_LEGACY_BOOTSCRIPT
    bool "Install legacy u-boot compatible /boot/boot.ub script"
    help
      For pre-distroboot systems this can be used to customize the command line

config DS_PACKAGE_LEGACY_BOOTSCRIPT_CMDLINE
    string "Boot script legacy CMDLINE"
    depends on DS_PACKAGE_LEGACY_BOOTSCRIPT
    help
      Sets the "cmdline_append" variable in u-boot

config DS_PACKAGE_LEGACY_BOOTSCRIPT_INSTALL_SOURCE
    bool "Install legacy boot script source file to /boot/boot.source"
    depends on DS_PACKAGE_LEGACY_BOOTSCRIPT
    help
      Install the legacy script source to the image. This can be used to
      change the script on the unit itself
```

## packages/resize/Kconfig
```kconfig
config DS_PACKAGE_RESIZE
    bool "resize"
    help
      Installs a "resize" utility to match the terminal size of your host.  This
      is similar to xterm's resize utility, but without pulling in xterm and its
      dependencies.
```

## tasks/Kconfig
```kconfig
source "tasks/core/Kconfig"
source "tasks/distros/Kconfig"
source "tasks/kernel/Kconfig"
source "tasks/components/Kconfig"
source "tasks/image_configuration/Kconfig"
source "tasks/image_output/Kconfig"
```

## tasks/components/Kconfig
```kconfig
menu "Components"

menu "Hardware Specific Components"

menu "embeddedTS"
menu "Bootloader Binaries"
source "tasks/components/ts7400v2-uboot/Kconfig"
source "tasks/components/ts7670-uboot/Kconfig"
endmenu
source "tasks/components/legacy-bootscript/Kconfig"
source "tasks/components/ts4100-utils/Kconfig"
source "tasks/components/ts4900-utils/Kconfig"
source "tasks/components/ts7100-utils/Kconfig"
source "tasks/components/ts7670-utils/Kconfig"
source "tasks/components/ts4900-fpga/Kconfig"
source "tasks/components/tssupervisorupdate/Kconfig"
source "tasks/components/ts-uboot-env-configs/Kconfig"
source "tasks/components/ts-touchscreen-calibration/Kconfig"
source "tasks/components/udev-rules/Kconfig"
endmenu

menu "NXP"
source "tasks/components/xorg-etnaviv/Kconfig"
endmenu

menu "Microchip"
source "tasks/components/wilc-firmware/Kconfig"
source "tasks/components/wilc3000-external-module/Kconfig"
endmenu

menu "TI"
source "tasks/components/wl12xx-firmware/Kconfig"
endmenu
endmenu

source "tasks/components/linux-firmware/Kconfig"
source "tasks/components/distroboot-scripts/Kconfig"
source "tasks/components/watchdog/Kconfig"
source "tasks/components/resize/Kconfig"

menu "Additional Graphical Components"
menu "Light and Versatile Graphics Library (LVGL)"
source "tasks/components/liblvgl/Kconfig"
source "tasks/components/lv_drivers/Kconfig"
endmenu
source "tasks/components/startx-service/Kconfig"
source "tasks/components/ts7100z-lvgl-ui-demo/Kconfig"
endmenu
endmenu
```

## tasks/components/distroboot-scripts/Kconfig
```kconfig
config DS_COMPONENT_DISTROBOOT_SCRIPTS
	bool "Install distroboot compatible /boot/boot.scr script"
	help
	  For newer U-Boots with distroboot a valid /boot/boot.scr script
	  is needed to boot the system.

config DS_COMPONENT_DISTROBOOT_SCRIPTS_INSTALL_SOURCE
	bool "Install distroboot script source file to /boot/boot.source"
	depends on DS_COMPONENT_DISTROBOOT_SCRIPTS
	help
	  Install the distroboot script source to the image. This can be used to
	  change the script on the unit itself
```

## tasks/components/liblvgl/Kconfig
```kconfig
config DS_COMPONENT_LIBLVGL
	bool "liblvgl"
	help
	  Build and install libraries and header files to support
	  the Light and Versatile Graphics Library (LVGL). This
	  requires an externally provided lv_conf.h file to handle
	  the build configuration.

config DS_COMPONENT_LIBLVGL_LVCONF
	string "Path to lv_conf.h"
	depends on DS_COMPONENT_LIBLVGL
	help
	  Path to lv_conf.h file used for build configuration
```

## tasks/components/linux-firmware/Kconfig
```kconfig
config DS_COMPONENT_LINUX_FIRMWARE
	bool "linux-firmware"
	help
	  Allows installing firmware files from linux-firmware git

config DS_COMPONENT_LINUX_FIRMWARE_QCA9377
	bool "Installs QCA9377 Firmware Files"
	depends on DS_COMPONENT_LINUX_FIRMWARE
	help
	  Installs support for QCA9377 based devices
```

## tasks/components/lv_drivers/Kconfig
```kconfig
config DS_COMPONENT_LV_DRIVERS
	bool "lv_drivers"
	depends on DS_COMPONENT_LIBLVGL
	help
	  Drivers package for LVGL. This provides a number of interface
	  routines for things such as libinput, fbdev, wayland, etc. It
	  builds and installs libraries and header files to the target.

	  This requires LVGL to be enabled and built. This will have
	  access to lv_conf.h already from LVGL. Additionally, another
	  configuration file, lv_drv_conf.h, is needed by lv_drivers in
	  order to configure the build properly.

comment "lv_drivers needs liblvgl"
	depends on !DS_COMPONENT_LIBLVGL

config DS_COMPONENT_LV_DRIVERS_LVDRVCONF
	string "Path to lv_drv_conf.h"
	depends on DS_COMPONENT_LV_DRIVERS
	help
	  Path to lv_drv_conf.h file used for build configuration
```

## tasks/components/ts-touchscreen-calibration/Kconfig
```kconfig
config DS_COMPONENT_TS_TOUCHSCREEN_CALIBRATIONS
	bool "Install embeddedTS touchscreen calibration"

config DS_COMPONENT_TS_X11_CALIBRATION
	bool "Install embeddedTS's x11 resistive touchscreen calibration files"
	depends on DS_COMPONENT_TS_TOUCHSCREEN_CALIBRATIONS
	help
	  Installs x11 touchscreen calibration values for:
	  TS-TPC-8390
	  TS-TPC-8950
	  TS-TPC-7990
```

## tasks/components/ts-uboot-env-configs/Kconfig
```kconfig
config DS_COMPONENT_TS_UBOOT_CONFIGS
	bool "Install U-Boot tools and embeddedTS's fw_env.config files to work together"
	help
	  Installs tools so that Linux can access U-Boot's saved environment(s), and also
          embeddedTS's fw_env.config files (to /usr/share/uboot-env-configs/), as well as
          a startup service to select the correct config file for the running board/U-Boot.
```

## tasks/components/ts4100-utils/Kconfig
```kconfig
config DS_COMPONENT_TS4100_UTILS
	bool "ts4100-utils"
	help
	  Utilities tools for TS-4100 SoM

	  Includes tools to communicate with the supervisory
	  microcontroller, TS-SILO monitor script, interface to FPGA,
	  and ZPU utilities
```

## tasks/components/ts4900-utils/Kconfig
```kconfig
config DS_PACKAGE_TS4900_UTILS
	bool "ts4900-utils"
	help
	  This includes tools like tshwctl to control the crossbar for the onboard
	  FPGA, get board versions, and misc board specific utils
```
