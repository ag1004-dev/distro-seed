## tasks/image_output/ext/Kconfig
```kconfig
config DS_IMAGE_ROOTFS_EXT
	bool "ext2/3/4 root filesystem"
	help
	  Build an ext2/3/4 root filesystem

choice
	depends on DS_IMAGE_ROOTFS_EXT
	prompt "ext2/3/4 variant"
	default DS_IMAGE_ROOTFS_EXT_EXT4

config DS_IMAGE_ROOTFS_EXT_EXT2
	bool "ext2"

config DS_IMAGE_ROOTFS_EXT_EXT3
	bool "ext3"

config DS_IMAGE_ROOTFS_EXT_EXT4
	bool "ext4"

endchoice

choice
	prompt "compression method"
	depends on DS_IMAGE_ROOTFS_EXT
	default DS_IMAGE_ROOTFS_EXT_NONE
	help
	  In addition to outputting a file like rootfs.ext4 this can output a
	  compressed copy.

config DS_IMAGE_ROOTFS_EXT_NONE
	bool "no compression"

config DS_IMAGE_ROOTFS_EXT_XZ
	bool "xz"

config DS_IMAGE_ROOTFS_EXT_BZ2
	bool "bzip2"

endchoice

config DS_IMAGE_ROOTFS_EXT_VER
	depends on DS_IMAGE_ROOTFS_EXT
	int
	default 2 if DS_IMAGE_ROOTFS_EXT_EXT2
	default 3 if DS_IMAGE_ROOTFS_EXT_EXT3
	default 4 if DS_IMAGE_ROOTFS_EXT_EXT4

config DS_IMAGE_ROOTFS_EXT_LABEL
	string "filesystem label"
	depends on DS_IMAGE_ROOTFS_EXT
	default "rootfs"

config DS_IMAGE_ROOTFS_EXT_SIZE
	string "filesystem size"
	depends on DS_IMAGE_ROOTFS_EXT
	default "2G"
	help
	  Specify size of the ext partition.
	  256M would be 256MiB
	  1G would be 1024MiB

config DS_IMAGE_ROOTFS_EXT_MKFS_OPTS
	string "additional mkfs options"
	depends on DS_IMAGE_ROOTFS_EXT
	help
	  These are options passed to mkfs when creating the filesystem.
	  Eg:
	  ext4 compatibility with older u-boots: -O ^metadata_csum,^64bit
```

## tasks/image_output/genimage/Kconfig
```kconfig
config DS_GENIMAGE
    bool "Create image with genimage"
    help
      Generates a disk image from a config file and the other generated files

config DS_GENIMAGE_PATH
    string "Path to genimage config file"
    depends on DS_GENIMAGE
    help
      Path relative to distro-seed to the genimage config file
```

## tasks/kernel/Kconfig
```kconfig
menu "Kernel"

choice
	prompt "Kernel version"
	default DS_KERNEL_PROVIDER_GIT

config DS_KERNEL_PROVIDER_GIT
	bool "Kernel source provider is custom git repository"
	help
	  This option allows distro-seed to grab the kernel sources from git

endchoice

if DS_KERNEL_PROVIDER_GIT
config DS_KERNEL_PROVIDER_GIT_URL
	string "URL of git repository"
	help
	  Specify git repo to fetch kernel. This can be specified as:
	  git://path/to/repo.git
	  https://path/to/repo.git
	  /path/to/locally/cloned/kernel/git/

config DS_KERNEL_PROVIDER_GIT_VERSION
	string "Kernel GIT srcrev"
	help
	  Specify tag or branch to checkout before building.
	  This is optional if the provider git url points to a local path.
endif

config DS_KERNEL_DEFCONFIG
	string "Kernel defconfig"
	help
	  Specify kernel defconfig to use

config DS_KERNEL_INSTALL_DEVICETREE_FILESYSTEM
	string "Names of device tree targets to install on the target"
	help   
	  Device tree names to install on the target, eg:
	  foo
	  would build foo.dtb and install it to /boot/foo.dtb

config DS_KERNEL_INSTALL_ZIMAGE_FILESYSTEM
	bool "Install zImage to the target filesystem in /boot/"

config DS_KERNEL_INSTALL_UIMAGE_FILESYSTEM
	bool "Install legacy uImage to the target filesystem in /boot/"

config DS_KERNEL_INSTALL_UIMAGE_LOADADDR
	hex "uImage Loadaddr"
	depends on DS_KERNEL_INSTALL_UIMAGE_FILESYSTEM
	help
	  Specify the load address for the kernel. This is required for the
	  uImage kernel format.  This is usually found in the target's U-Boot
	  from:  "env print loadaddr" or "env print kernel_addr_r"

endmenu
```
