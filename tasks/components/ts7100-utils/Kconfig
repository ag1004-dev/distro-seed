## tasks/components/ts7100-utils/Kconfig
```kconfig
config DS_COMPONENT_TS7100_UTILS
	bool "ts7100-utils"
	help
	  This set of utils is for the TS-7100 and TS-7250-V3 including tools for checking
	  board versions, keypad/lcd tools, pc104/fpga tools, etc.
```

## tasks/components/ts7100z-lvgl-ui-demo/Kconfig
```kconfig
config DS_COMPONENT_TS7100Z_LVGL_UI_DEMO
	bool "ts7100z-lvgl-ui-demo"
	depends on DS_COMPONENT_LIBLVGL
	depends on DS_COMPONENT_LV_DRIVERS
	help
	  Simple graphical demo for TS-7100-Z using LVGL

	  Includes the splash-screen image for I/O location reference;
	  control of the two relays; control of the 3 high-voltage,
	  low-side switches; feedback of the input path of those same
	  low-side switches via emulated LEDs; control of the 1 high-voltage,
	  high-side switch; and a meter display of the 4 0-12 V ADC inputs.

	  libgpiod and libiiod are used for GPIO and ADC control.

comment "ts7100z-lvgl-ui-demo needs liblvgl and lv_drivers"
	depends on !DS_COMPONENT_LV_DRIVERS
```

## tasks/components/ts7400v2-uboot/Kconfig
```kconfig
config DS_COMPONENT_TS7400V2_UBOOT
        bool "Binary bootable U-Boot blob for TS-7400-V2"
        help
          Pre-built binary blob for making bootable SD/eMMC devices.

          This is based on the 2014.10 U-Boot release which requires
          an older gcc 4.4 compiler which is not possible to build
          in modern Buildroot release. In order to still support this
          platform, this package provides a binary used as part of the
          final image build.

          THIS IS REQUIRED FOR A BOOTABLE TS-7400-V2 IMAGE!
```

## tasks/components/ts7400v2-utils/Kconfig
```kconfig
config DS_COMPONENT_TS7400V2_UTILS
	bool "ts7400v2-utils"
	help
	  Utilities tools for TS-7400-V2 SBC for use with 4.x and newer
	  kernels.

	  Includes tools to communicate with the supervisory
	  microcontroller, RTC NVRAM, and ADC helper.
```

## tasks/components/ts7553v2-utils/Kconfig
```kconfig
config DS_COMPONENT_TS7553V2_UTILS
	bool "ts7553v2-utils"
	help
	  Utilities tools for TS-7553-V2 SBC.

	  Includes tools to communicate with the supervisory
	  microcontroller, TS-SILO monitor script, and LCD + KPad
	  interface.
```

## tasks/components/ts7670-uboot/Kconfig
```kconfig
config DS_COMPONENT_TS7670_UBOOT
        bool "Binary bootable U-Boot blob for TS-7670"
        help
          Pre-built binary blob for making bootable SD/eMMC devices.

          This is based on the 2014.10 U-Boot release which requires
          an older gcc 4.4 compiler which is not possible to build
          in modern Buildroot release. In order to still support this
          platform, this package provides a binary used as part of the
          final image build.

          THIS IS REQUIRED FOR A BOOTABLE TS-7670 IMAGE!
```

## tasks/components/ts7670-utils/Kconfig
```kconfig
config DS_COMPONENT_TS7670_UTILS
	bool "ts7670-utils"
	help
	  Userspace utilities for controlling various aspects of the on-board
	  microcontroller and other platform information.
```

## tasks/components/tssupervisorupdate/Kconfig
```kconfig
config DS_COMPONENT_TSSUPERVISORUPDATE
	bool "tssupervisorupdate"
	help
	  This project is used to update the supervisory microcontroller on
	  embeddedTS products. This supports the TS-7250-V3, TS-7970, and more
	  in the future.
```

## tasks/components/udev-rules/Kconfig
```kconfig
config DS_COMPONENT_UDEV_RULES
	bool "Install udev rules scripts"

config DS_COMPONENT_UDEV_RULES_7100_TOUCH
	depends on DS_COMPONENT_UDEV_RULES
	bool "udev rules for TS-7100 resistive touschscreen"
	help
	  Installs a udev rules file for touchscreen calibration for
	  TS-7100-Z

config DS_COMPONENT_UDEV_RULES_4900_8390_TOUCH
	depends on DS_COMPONENT_UDEV_RULES
	bool "udev rules for TS-TPC-8390-4900 resistive touschscreen"
	help
	  Installs a udev rules file for touchscreen calibration for
	  TS-TPC-8390-4900

config DS_COMPONENT_UDEV_RULES_4900_8950_TOUCH
	depends on DS_COMPONENT_UDEV_RULES
	bool "udev rules for TS-TPC-8950-4900 resistive touschscreen"
	help
	  Installs a udev rules file for touchscreen calibration for
	  TS-TPC-8950-4900

config DS_COMPONENT_UDEV_RULES_7990_TOUCH
	depends on DS_COMPONENT_UDEV_RULES
	bool "udev rules for TS-TPC-7990 resistive touschscreen"
	help
	  Installs a udev rules file for touchscreen calibration for
	  TS-TPC-7990
```

## tasks/components/watchdog/Kconfig
```kconfig
config DS_WATCHDOG
	bool "watchdog service to reboot on lockup"
	help
	  Run watchdog service automatically on startup

config DS_WATCHDOG_DEVICE
	string "watchdog device"
	default "/dev/watchdog0"
	depends on DS_WATCHDOG
	help
	  This is the hardware watchdog device to monitor. This is normally
	  /dev/watchdog0.

config DS_WATCHDOG_TIMEOUT
	int "watchdog timeout seconds"
	default 60
	depends on DS_WATCHDOG
	help
	  The hardware timeout to use for a given device. This should generally
	  be around 60 seconds by default.
```

## tasks/components/wilc-firmware/Kconfig
```kconfig
config DS_PACKAGE_WILC3000_FIRMWARE
	bool "wilc3000-firmware"
	help
	  Installs Microchip Wilc3000 Firmware
```

## tasks/components/wilc3000-external-module/Kconfig
```kconfig
config DS_MODULE_WILC3000
	bool "wilc3000-module"
	help
	  This module provides the drivers from Microchip's linux4microchip git
```

## tasks/components/wl12xx-firmware/Kconfig
```kconfig
config DS_COMPONENT_WL12XX_FIRMWARE
	bool "ti-wl12xx-firmware"
	help
	  Installs TI Wl12xx firmware for modules like TIWI-BLE
```

## tasks/components/xorg-etnaviv/Kconfig
```kconfig
config DS_COMPONENT_XORG_ETNAVIV
	bool "xorg.conf.d files to support etnaviv gpu (i.MX6)"
	help
	  Used on i.MX6 based systems using Xorg+etnaviv
```

## tasks/core/Kconfig
```kconfig
### Default CONFIG options enabled all the time
config DS_CORE_CLEAN_WORK
    bool
    default "y"
config DS_CORE_CREATE_WORK
    bool
    default "y"
config DS_CORE_BUILD_HOST_DOCKER
    bool
    default "y"
config DS_CORE_GEN_DOCKER_ENV
    bool
    default "y"
config DS_CORE_COMBINE_OVERLAYS
    bool
    default "y"
config DS_CORE_CHROOT_PREP
    bool
    default "y"
config DS_APT_CONFIGURED
    bool
    default "y"
config DS_CORE_CHROOT_CLEAN
    bool
    default "y"
config DS_ROOTFS_IDENTIFIABLE
    bool
    default "y"
config DS_SET_TEMPORARY_RESOLV
    bool
    default "y"
config DS_CHROOT_READY
    bool
    default "y"
config DS_ROOTFS_READY
    bool
    default "y"
config DS_CORE_MULTISTRAP_CONF
    bool
    default "y"
config DS_CORE_PACKAGELIST
    bool
    default "y"
config DS_CORE_IMAGES_READY
    bool
    default "y"
config DS_CORE_PACKAGELIST_PREP
    bool
    default "y"
config DS_DISTRO_PACKAGELIST_EXTRA
    bool
    default "y"

# This task is never enabled. This task is only invoked form clean-cache.py,
# but this definition silences the warning from this manifest not finding
# matching Kconfig symbol.
config DS_CORE_CLEAN_CACHE
    bool
    default "n"
```

## tasks/core/rootfs_identification/Kconfig
```kconfig
config DS_ROOTFS_IDENTIFICATION
	bool "make rootfs identifiable"
	help
	  Create root.version and md5sums for checking this image
```

## tasks/image_configuration/Kconfig
```kconfig
menu "Image Configuration"

comment "Required Settings"
source "tasks/image_configuration/set-locales/Kconfig"
source "tasks/image_configuration/set-hostname/Kconfig"
source "tasks/image_configuration/set-timezone/Kconfig"
source "tasks/image_configuration/set-fstab/Kconfig"

comment "Optional Settings"
source "tasks/image_configuration/ssh-regen-keys/Kconfig"
source "tasks/image_configuration/update-command-not-found/Kconfig"
source "tasks/image_configuration/set-log-size/Kconfig"
source "tasks/image_configuration/purge-man-pages/Kconfig"
source "tasks/image_configuration/nfsroot-helper/Kconfig"
source "tasks/image_configuration/set-ntp/Kconfig"

endmenu
```

## tasks/image_configuration/downgrade-wpa-hostapd/Kconfig
```kconfig
config DS_DOWNGRADE_WPA_HOSTAPD
	default "n"
	bool "Downgrade wpa_supplicant and hostapd to 2.9"
	depends on DS_DISTRO_DEBIAN_12 || DS_DISTRO_UBUNTU_22_04 || DS_DISTRO_UBUNTU_23_04
	help
	  Say Y here to downgrade wpa_supplicant and hostapd to the 2.9
	  release. This is needed on platforms with the Silix Wi-Fi device
	  as there is some conflict between the driver, libnl, and the 2.10
	  release version of the above packages.

	  This will download an older binary release of these packages,
	  install them, and mark them to be kept back to prevent accidental
	  updating and breaking WPA.
```

## tasks/image_configuration/set-fw-env-config/Kconfig
```kconfig
config DS_GENERATE_FW_ENV_CONFIG
	default y
	bool "Generate an appropriate /etc/fw_env.config"
	help
	  Generate fw_env.config during first boot. Otherwise Linux does
          not know how to access the U-Boot environment. You should say
	  'y' here.
```

## tasks/image_configuration/set-hostname/Kconfig
```kconfig
# Enabled without an option, we always run this
config DS_SET_HOSTNAME
	bool
	default y

config DS_HOSTNAME
	string "Set hostname value"
	help
	  Set the hostname for the target system.  If it is left blank,
	  it defaults to ${DISTRO}-${RELEASE}-${TARGET_ARCH}
```

## tasks/image_configuration/set-locales/Kconfig
```kconfig
# Enabled without an option, we always run this
config DS_SET_LOCALES
	bool
	default y

config DS_LOCALES
	default "en_US.UTF-8"
	string "Set Locale value"
	help
	  Set the locale on the image. See "dpkg-reconfigure locales" for the 
	  full list

config DS_PURGE_LOCALES
	bool "Purge unused locales"
	help
	  Purges unused locales, all but what is specified in DS_LOCALES
```

## tasks/image_configuration/set-timezone/Kconfig
```kconfig
config DS_SET_TIMEZONE
	bool
	default y

config DS_TIMEZONE
	default "America/Phoenix"
	string "Set System Timezone"
	help
	  Set the timezone on the image.  See timezone from /usr/share/zoneinfo
	  for the list of all timezones.
```

## tasks/image_configuration/set-user/Kconfig
```kconfig
# We always configure users
config DS_SET_USERS
    bool
    default "y"

config DS_USER_ROOT_EN
    bool "Allow local login of root"
    default "n"
    help
      This option, when enabled, allows the local login of the 'root'
      user in the system. It's usually recommended for system administration
      and should be used with caution due to the elevated privileges
      of the 'root' user. If unsure, say N.

config DS_USER_ROOT_PASSWORD
    depends on DS_USER_ROOT_EN
    string "default root password"
    help
      If 'Allow local login of root' is enabled, you can set a default password 
      for the 'root' user.

config DS_USER
    bool "Create normal user"
    help
      Enabling this option will create a non-privileged, normal user on the system.
      This is generally recommended for performing tasks that don't require elevated 
      privileges.

config DS_USER_NAME
    string "username"
    depends on DS_USER
    default "user"
    help
      If 'Create normal user' is enabled, this option allows you to specify the 
      username of the created user.

config DS_USER_PASSWORD
    string "default password"
    depends on DS_USER
    help
      This option allows you to set a default password for the newly created user.

config DS_USER_SUDO
    bool "Enable sudo"
    depends on DS_USER
    help
      This option includes and enables sudo for the new user.

config DS_USER_GROUPS
    string "additional user groups"
    depends on DS_USER
    help
      This option is used to specify additional user groups for the created user.
      Groups should be space separated.
```

## tasks/image_configuration/ssh-regen-keys/Kconfig
```kconfig
config DS_REGENERATE_SSH_KEYS
	default y
	bool "Regenerate SSH keys (YOU REALLY WANT THIS IF INSTALLING SSHD)"
	help
	  Remove target image's generated SSH host keys and generate new host
	  keys at system bootup if they do not exist.

	  This has the side effect of generating host keys on boot if they are
	  removed for any reason. If you want to disable sshd, disable it from
	  starting instead of removing its keys.

	  Otherwise, the image generated will have the keys baked in to it and
	  all devices the image is installed to will have the same keys.

	  YOU REALLY WANT TO SAY 'y' HERE IF SSH IS INSTALLED IN THE IMAGE UNLESS
	  YOU ARE SURE YOU KNOW WHAT YOU ARE DOING!
```

## tasks/image_output/Kconfig
```kconfig
menu "Output Image"

source "tasks/image_output/tar/Kconfig"
source "tasks/image_output/ext/Kconfig"

endmenu
```
