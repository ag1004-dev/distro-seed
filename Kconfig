## distros/Kconfig
```kconfig
menu "Distribution"
choice
        prompt "Architecture"
        default DS_ARCH_ARMHF
config DS_ARCH_ARMHF
        bool "armhf"
        help
          Target armhf (arm32 hard float) system
config DS_ARCH_ARMEL
        bool "armel"
        help
          Target armel (arm32 soft float) system
endchoice

choice
        prompt "Base Distribution"
config DS_DISTRO_DEBIAN_11
	bool "Debian 11 Bullseye"
	help
	  Use Debian 11 Bullseye as the base distribution
	
config DS_DISTRO_DEBIAN_12
	bool "Debian 12 Bookworm"
	help
	  Use Debian 12 Bookworm as the base distribution

config DS_DISTRO_UBUNTU_22_04
	bool "Ubuntu 22.04 Jammy Jellyfish"
	help
	  Use Ubuntu 22.04 as the base distribution

config DS_DISTRO_UBUNTU_23_04
	bool "Ubuntu 23.04 Lunar Lobster"
	help
	  Use Ubuntu 23.04 as the base distribution

endchoice

config DS_PACKAGELIST
	string "Package List"
	help
	  Set a package list to use to generate the image. See the files under
	  packagelist/

	default "debian-11-minimal.txt" if DS_DISTRO_DEBIAN_11 
	default "debian-12-minimal.txt" if DS_DISTRO_DEBIAN_12
	default "ubuntu_22_04-minimal.txt" if DS_DISTRO_UBUNTU_22_04
	default "ubuntu_22304-minimal.txt" if DS_DISTRO_UBUNTU_23_04
endmenu
```

## generators/tar/Kconfig
```kconfig
config DS_IMAGE_ROOTFS_TAR
	bool "rootfs tar"
	help
	  Outputs image in a single tar

if  DS_IMAGE_ROOTFS_TAR
choice
        prompt "Tar compression format"
        default DS_IMAGE_ROOTFS_TAR_XZ

config DS_IMAGE_ROOTFS_TAR_NONE
        bool "No compression"

config DS_IMAGE_ROOTFS_TAR_XZ
        bool "xz compression"

config DS_IMAGE_ROOTFS_TAR_BZIP2
        bool "bz2 compression"

endchoice
endif
```

## image/Kconfig
```kconfig
menu "Image Configuration"

comment "Required Settings"
source "image/set-locales/Kconfig"
source "image/set-hostname/Kconfig"
source "image/set-timezone/Kconfig"
source "image/set-fstab/Kconfig"

comment "Optional Settings"
source "image/ssh-regen-keys/Kconfig"
source "image/update-command-not-found/Kconfig"
source "image/set-log-size/Kconfig"
source "image/purge-man-pages/Kconfig"

endmenu
```

## image/nfsroot-helper/Kconfig
```kconfig
config DS_NFSROOT_FIXUP
	default y
	bool "NFSROOT dns support"
	help
	  When booting an nfsroot the resolv.conf is not normally set up
	  automatically. This adds a check on startup to read the DNS and search
	  domain advertised on DHCP, and sets up a valid resolv.conf.
```

## image/purge-man-pages/Kconfig
```kconfig
config PURGE_MAN_PAGES
	bool "Purge man pages"
	help
	  Removes man pages from image.  Saves roughly 10-20MB
```

## image/set-fstab/Kconfig
```kconfig
choice
	prompt "fstab provider"
	default DS_FSTAB_GEN

config DS_FSTAB_GEN
	bool "Generate simple fstab"
	help
	  Use Kconfig settings to generate a basic kconfig file

config DS_FSTAB_FILE
	bool "User provided fstab"
	help
	  If selected, fstab will be provided by a user selected file
endchoice

config DS_FSTAB_FILE_PATH
	string "fstab file path"
	depends on DS_FSTAB_FILE
	help
	  Path to the fstab to use in the target image

menu "geneated fstab options"
	depends on DS_FSTAB_GEN

config DS_FSTAB_GEN_ROOT_DEVICE
	string "rootfs device"
	default "/dev/root"

config DS_FSTAB_GEN_ROOT_FS
	string "rootfs filesystem"
	default "ext4"

config DS_FSTAB_GEN_ROOT_OPTIONS
	string "rootfs mount options"
	default "defaults"
endmenu
```
