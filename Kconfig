## components/Kconfig
```kconfig
menu "Components"

menu "Hardware Specific Components"

menu "embeddedTS"
source "components/legacy-bootscript/Kconfig"
source "components/ts4900-utils/Kconfig"
source "components/ts7100-utils/Kconfig"
source "components/ts4900-fpga/Kconfig"
source "components/tssupervisorupdate/Kconfig"
endmenu

menu "Microchip"
source "components/wilc-firmware/Kconfig"
source "components/wilc3000-external-module/Kconfig"
endmenu

menu "TI"
source "components/wl12xx-firmware/Kconfig"
endmenu
endmenu

source "components/distroboot-scripts/Kconfig"
source "components/resize/Kconfig"

endmenu
```

## components/distroboot-scripts/Kconfig
```kconfig
config DS_PACKAGE_DISTROBOOT_SCRIPTS
    bool "Install distroboot compatible /boot/boot.scr script"
    help
      For newer u-boots with distroboot a valid /boot/boot.scr script
      is needed to boot the system.

config DS_PACKAGE_DISTROBOOT_SCRIPTS_INSTALL_SOURCE
    bool "Install distroboot script source file to /boot/boot.source"
    depends on DS_PACKAGE_DISTROBOOT_SCRIPTS
    help
      Install the distroboot script source to the image. This can be used to
      change the script on the unit itself
```

## components/startx-service/Kconfig
```kconfig
config DS_XORG_STARTX_SERVICE
	bool "startx service to launch kiosk applications"
	help
	  Run startx automatically on startup

config DS_XORG_STARTX_SERVICE_TARGET
	string "startx application"
	depends on DS_XORG_STARTX_SERVICE
	default "xterm"
	help
	  Application to launch

config DS_XORG_STARTX_SERVICE_NO_DECORATIONS
	bool "Hide titlebars and cursor"
	depends on DS_XORG_STARTX_SERVICE
	help
	  Launches the matchbox window manager with the cursor and titlebar
	  disabled
```

## components/ts-uboot-env-configs/Kconfig
```kconfig
config DS_COMPONENT_TS_UBOOT_CONFIGS
    bool "Install embeddedTS's u-boot fw_env.config files"
    help
      Installs embeddedTS's u-boot fw_env.config files to /usr/share/uboot-env-configs/
```

## components/ts4900-fpga/Kconfig
```kconfig
config DS_PACKAGE_TS4900_FPGA
    bool "ts4900-fpga"
    help
      Installs a /boot/ts4900-fpga.bin to get loaded on startup on TS-4900 platforms.
```

## components/wl12xx-firmware/Kconfig
```kconfig
config DS_PACKAGE_WL12XX_FIRMWARE
    bool "ti-wl12xx-firmware"
    help
      Installs TI Wl12xx firwmare for modules like TIWI-BLE
```

## configs/ts7400v2_debian_12_minimal_defconfig
```kconfig
CONFIG_DS_ARCH_ARMEL=y
CONFIG_DS_DISTRO_DEBIAN_12=y
CONFIG_DS_PACKAGELIST="debian_12_minimum.txt"
CONFIG_DS_KERNEL_PROVIDER_GIT_URL="https://github.com/embeddedTS/linux-lts.git"
CONFIG_DS_KERNEL_PROVIDER_GIT_VERSION="v5.10.170.5-ts"
CONFIG_DS_KERNEL_DEFCONFIG="tsimx28_minimal_defconfig"
CONFIG_DS_KERNEL_INSTALL_DEVICETREE_FILESYSTEM="imx28-ts7670 imx28-ts7400v2"
CONFIG_DS_KERNEL_INSTALL_UIMAGE_FILESYSTEM=y
CONFIG_DS_KERNEL_INSTALL_UIMAGE_LOADADDR=0x40008000
CONFIG_DS_COMPONENT_TS7400V2_UBOOT=y
CONFIG_DS_COMPONENT_TS7670_UTILS=y
CONFIG_DS_COMPONENT_WL12XX_FIRMWARE=y
CONFIG_DS_COMPONENT_RESIZE=y
CONFIG_DS_PURGE_LOCALES=y
CONFIG_DS_HOSTNAME="tsimx28"
CONFIG_DS_TIMEZONE="America/Phoenix"
# CONFIG_DS_REGENERATE_SSH_KEYS is not set
# CONFIG_DS_REGENERATE_COMMAND_NOT_FOUND is not set
# CONFIG_DS_USE_NTPSERVER is not set
CONFIG_DS_IMAGE_ROOTFS_EXT=y
CONFIG_DS_IMAGE_ROOTFS_EXT_SIZE="512M"
CONFIG_DS_GENIMAGE=y
CONFIG_DS_GENIMAGE_PATH="genimage/tsimx28.cfg"
```

## configs/ts7553v2_debian_12_headless_defconfig
```kconfig
CONFIG_DS_DISTRO_DEBIAN_12=y
CONFIG_DS_PACKAGELIST="debian_12_headless.txt"
CONFIG_DS_DISTRO_PACKAGELIST_APPEND="libcairo2"
CONFIG_DS_KERNEL_PROVIDER_GIT_URL="https://github.com/embeddedTS/linux-lts.git"
CONFIG_DS_KERNEL_PROVIDER_GIT_VERSION="v5.10.209.2-ts"
CONFIG_DS_KERNEL_DEFCONFIG="tsimx6ul_defconfig"
CONFIG_DS_KERNEL_INSTALL_DEVICETREE_FILESYSTEM="imx6ul-ts7553v2"
CONFIG_DS_KERNEL_INSTALL_ZIMAGE_FILESYSTEM=y
CONFIG_DS_COMPONENT_TS7553V2_UTILS=y
CONFIG_DS_COMPONENT_WILC3000_FIRMWARE=y
CONFIG_DS_MODULE_WILC3000=y
CONFIG_DS_WATCHDOG=y
CONFIG_DS_COMPONENT_RESIZE=y
CONFIG_DS_USER_ROOT_EN=y
CONFIG_DS_PURGE_LOCALES=y
CONFIG_DS_HOSTNAME="tsimx6ul"
CONFIG_DS_TIMEZONE="America/Phoenix"
CONFIG_DS_IMAGE_ROOTFS_TAR=y
```

## configs/tsa38x_debian_12_minimal_defconfig
```kconfig
CONFIG_DS_DISTRO_DEBIAN_12=y
CONFIG_DS_PACKAGELIST="debian_12_minimum.txt"
CONFIG_DS_KERNEL_PROVIDER_GIT_URL="https://github.com/embeddedTS/linux-lts.git"
CONFIG_DS_KERNEL_PROVIDER_GIT_VERSION="v5.10.170.7-ts"
CONFIG_DS_KERNEL_DEFCONFIG="tsa38x_minimal_defconfig"
CONFIG_DS_KERNEL_INSTALL_DEVICETREE_FILESYSTEM="armada-385-ts7800-v2 armada-385-ts7840"
CONFIG_DS_KERNEL_INSTALL_ZIMAGE_FILESYSTEM=y
CONFIG_DS_COMPONENT_WILC3000_FIRMWARE=y
CONFIG_DS_MODULE_WILC3000=y
CONFIG_DS_COMPONENT_DISTROBOOT_SCRIPTS=y
CONFIG_DS_WATCHDOG=y
CONFIG_DS_COMPONENT_RESIZE=y
CONFIG_DS_USER_ROOT_EN=y
CONFIG_DS_PURGE_LOCALES=y
CONFIG_DS_HOSTNAME="tsa38x"
# CONFIG_DS_REGENERATE_SSH_KEYS is not set
# CONFIG_DS_REGENERATE_COMMAND_NOT_FOUND is not set
# CONFIG_DS_USE_NTPSERVER is not set
CONFIG_DS_IMAGE_ROOTFS_TAR=y
```

## configs/tsa38x_ubuntu_23_04_headless_defconfig
```kconfig
CONFIG_DS_DISTRO_UBUNTU_23_04=y
CONFIG_DS_PACKAGELIST="ubuntu_23.04_headless.txt"
CONFIG_DS_KERNEL_PROVIDER_GIT_URL="https://github.com/embeddedTS/linux-lts.git"
CONFIG_DS_KERNEL_PROVIDER_GIT_VERSION="v5.10.170.7-ts"
CONFIG_DS_KERNEL_DEFCONFIG="tsa38x_defconfig"
CONFIG_DS_KERNEL_INSTALL_DEVICETREE_FILESYSTEM="armada-385-ts7800-v2 armada-385-ts7840"
CONFIG_DS_KERNEL_INSTALL_ZIMAGE_FILESYSTEM=y
#CONFIG_DS_COMPONENT_LEGACY_BOOTSCRIPT is not set
#CONFIG_DS_COMPONENT_LEGACY_BOOTSCRIPT_CMDLINE="console=ttymxc0,115200 init=/sbin/init loglevel=4"
CONFIG_DS_COMPONENT_WILC3000_FIRMWARE=y
CONFIG_DS_MODULE_WILC3000=y
CONFIG_DS_WATCHDOG=y
CONFIG_DS_COMPONENT_RESIZE=y
CONFIG_DS_USER=y
CONFIG_DS_USER_PASSWORD="user"
CONFIG_DS_USER_SUDO=y
CONFIG_DS_PURGE_LOCALES=y
CONFIG_DS_HOSTNAME="tsa38x"
CONFIG_DS_TIMEZONE="America/Phoenix"
CONFIG_DS_IMAGE_ROOTFS_TAR=y
CONFIG_DS_IMAGE_ROOTFS_TAR_XZ=y
```

## configs/tsimx6-debian-12-x11_defconfig
```kconfig
#
# Distribution
#
CONFIG_DS_ARCH_ARMHF=y
# CONFIG_DS_ARCH_ARMEL is not set
# CONFIG_DS_DISTRO_DEBIAN_11 is not set
CONFIG_DS_DISTRO_DEBIAN_12=y
# CONFIG_DS_DISTRO_UBUNTU_22_04 is not set
# CONFIG_DS_DISTRO_UBUNTU_23_04 is not set
CONFIG_DS_PACKAGELIST="debian-12-slim-xfce4.txt"
# end of Distribution

#
# Kernel
#
CONFIG_DS_KERNEL_PROVIDER_GIT=y
CONFIG_DS_KERNEL_PROVIDER_GIT_URL="https://github.com/embeddedTS/linux-lts.git"
CONFIG_DS_KERNEL_PROVIDER_GIT_VERSION="v5.10.170.5-ts"
CONFIG_DS_KERNEL_DEFCONFIG="tsimx6_defconfig"
CONFIG_DS_KERNEL_INSTALL_DEVICETREE_FILESYSTEM="imx6q-ts7970 imx6dl-ts7970"
CONFIG_DS_KERNEL_INSTALL_ZIMAGE_FILESYSTEM=y
CONFIG_DS_KERNEL_INSTALL_UIMAGE_FILESYSTEM=y
CONFIG_DS_KERNEL_INSTALL_UIMAGE_LOADADDR=0x10008000
# end of Kernel

#
# Components
#

#
# Hardware Specific Components
#

#
# embeddedTS
#
CONFIG_DS_PACKAGE_LEGACY_BOOTSCRIPT=y
CONFIG_DS_PACKAGE_LEGACY_BOOTSCRIPT_CMDLINE="console=ttymxc0,115200 init=/sbin/init loglevel=4"
CONFIG_DS_PACKAGE_LEGACY_BOOTSCRIPT_INSTALL_SOURCE=y
CONFIG_DS_PACKAGE_TS4900_UTILS=y
# CONFIG_DS_PACKAGE_TS7100_UTILS is not set
CONFIG_DS_PACKAGE_TS4900_FPGA=y
CONFIG_DS_PACKAGE_TSSUPERVISORUPDATE=y
CONFIG_DS_COMPONENT_TS_UBOOT_CONFIGS=y
# end of embeddedTS

#
# NXP
#
CONFIG_DS_COMPONENT_XORG_ETNAVIV=y
# end of NXP

#
# Microchip
#
CONFIG_DS_PACKAGE_WILC3000_FIRMWARE=y
CONFIG_DS_MODULE_WILC3000=y
# end of Microchip

#
# TI
#
CONFIG_DS_PACKAGE_WL12XX_FIRMWARE=y
# end of TI
# end of Hardware Specific Components

# CONFIG_DS_PACKAGE_DISTROBOOT_SCRIPTS is not set
CONFIG_DS_PACKAGE_RESIZE=y
CONFIG_DS_XORG_STARTX_SERVICE=y
CONFIG_DS_XORG_STARTX_SERVICE_TARGET="xterm"
# CONFIG_DS_XORG_STARTX_SERVICE_NO_DECORATIONS is not set
# end of Components

#
# Image Configuration
#

#
# Required Settings
#
CONFIG_DS_LOCALES="en_US.UTF-8"
CONFIG_DS_PURGE_LOCALES=y
CONFIG_DS_HOSTNAME="tsimx6"
CONFIG_DS_TIMEZONE="America/Phoenix"
CONFIG_DS_FSTAB_GEN=y
# CONFIG_DS_FSTAB_FILE is not set

#
# geneated fstab options
#
CONFIG_DS_FSTAB_GEN_ROOT_DEVICE="/dev/root"
CONFIG_DS_FSTAB_GEN_ROOT_FS="ext4"
CONFIG_DS_FSTAB_GEN_ROOT_OPTIONS="defaults"
# end of geneated fstab options

#
# Optional Settings
#
CONFIG_DS_REGENERATE_SSH_KEYS=y
CONFIG_DS_REGENERATE_COMMAND_NOT_FOUND=y
# CONFIG_DS_JOURNAL_SIZE_OVERRIDE is not set
# CONFIG_DS_PURGE_MAN_PAGES is not set
CONFIG_DS_NFSROOT_FIXUP=y
CONFIG_DS_USE_NTPSERVER=y
CONFIG_DS_USE_NTPSERVER_PROVIDER="time.cloudflare.com"
# end of Image Configuration

#
# Output Image
#
CONFIG_DS_IMAGE_ROOTFS_TAR=y
CONFIG_DS_IMAGE_ROOTFS_TAR_NONE=y
# CONFIG_DS_IMAGE_ROOTFS_TAR_XZ is not set
# CONFIG_DS_IMAGE_ROOTFS_TAR_BZIP2 is not set
# end of Output Image
```

## configs/tsimx6-ubuntu-23_04-minimal_defconfig
```kconfig
CONFIG_DS_DISTRO_UBUNTU_23_04=y
CONFIG_DS_PACKAGELIST="ubuntu-23_04-minimum.txt"
CONFIG_DS_KERNEL_PROVIDER_GIT_URL="https://github.com/embeddedTS/linux-lts.git"
CONFIG_DS_KERNEL_PROVIDER_GIT_VERSION="v5.10.170.4-ts"
CONFIG_DS_KERNEL_DEFCONFIG="tsimx6_minimal_defconfig"
CONFIG_DS_KERNEL_INSTALL_DEVICETREE_FILESYSTEM="imx6q-ts7970 imx6dl-ts7970"
CONFIG_DS_KERNEL_INSTALL_UIMAGE_FILESYSTEM=y
CONFIG_DS_KERNEL_INSTALL_UIMAGE_LOADADDR=0x10008000
CONFIG_DS_COMPONENT_LEGACY_BOOTSCRIPT=y
CONFIG_DS_COMPONENT_LEGACY_BOOTSCRIPT_CMDLINE="console=ttymxc0,115200 init=/sbin/init loglevel=4"
CONFIG_DS_COMPONENT_TS4900_FPGA=y
CONFIG_DS_COMPONENT_RESIZE=y
CONFIG_DS_PURGE_LOCALES=y
# CONFIG_DS_REGENERATE_SSH_KEYS is not set
# CONFIG_DS_REGENERATE_COMMAND_NOT_FOUND is not set
# CONFIG_DS_USE_NTPSERVER is not set
CONFIG_DS_IMAGE_ROOTFS_TAR=y
CONFIG_DS_IMAGE_ROOTFS_TAR_NONE=y
```

## configs/tsimx6_debian_11_minimal_defconfig
```kconfig
#
# Target Options
#
CONFIG_ARCH_ARMHF=y
# CONFIG_ARCH_ARMEL is not set
# end of Target Options

#
# Distribution
#
CONFIG_DISTRO_DEBIAN_11=y
# CONFIG_DISTRO_DEBIAN_12 is not set
# CONFIG_DISTRO_UBUNTU_22_04 is not set
CONFIG_PACKAGELIST="debian-11-minimal.txt"
# end of Distribution

#
# Kernel
#
CONFIG_KERNEL_PROVIDER_GIT=y
CONFIG_KERNEL_PROVIDER_GIT_URL="https://github.com/embeddedTS/linux-lts.git"
CONFIG_KERNEL_PROVIDER_GIT_VERSION="v5.10.170.4-ts"
CONFIG_KERNEL_DEFCONFIG="tsimx6_minimal_defconfig"
CONFIG_KERNEL_INSTALL_DEVICETREE_FILESYSTEM="imx6q-ts7970 imx6dl-ts7970"
CONFIG_KERNEL_INSTALL_ZIMAGE_FILESYSTEM=y
# end of Kernel

#
# Packages
#
# CONFIG_PACKAGE_DISTROBOOT_SCRIPTS is not set

#
# Hardware Specific Packages
#
CONFIG_PACKAGE_TS4900_UTILS=y
# end of Hardware Specific Packages
# end of Packages

#
# Image Configuration
#
CONFIG_REGENERATE_SSH_KEYS=y
CONFIG_REGENERATE_COMMAND_NOT_FOUND=y
CONFIG_TIMEZONE_OVERRIDE=y
CONFIG_TIMEZONE_VALUE="US/Arizona"
# end of Image Configuration

#
# Output Image
#
CONFIG_IMAGE_ROOTFS_TAR=y
# CONFIG_IMAGE_ROOTFS_TAR_NONE is not set
CONFIG_IMAGE_ROOTFS_TAR_XZ=y
# CONFIG_IMAGE_ROOTFS_TAR_BZIP2 is not set
# end of Output Image
```

## configs/tsimx6_debian_12_headless_defconfig
```kconfig
CONFIG_DS_DISTRO_DEBIAN_12=y
CONFIG_DS_PACKAGELIST="debian_12_headless.txt"
CONFIG_DS_KERNEL_PROVIDER_GIT_URL="https://github.com/embeddedTS/linux-lts.git"
CONFIG_DS_KERNEL_PROVIDER_GIT_VERSION="v5.10.208-ts"
CONFIG_DS_KERNEL_DEFCONFIG="tsimx6_defconfig"
CONFIG_DS_KERNEL_INSTALL_DEVICETREE_FILESYSTEM="imx6dl-ts4900-14 imx6dl-ts4900-2 imx6dl-ts4900 imx6dl-ts7970 imx6dl-ts7990-lxd imx6dl-ts7990-lxd-revb imx6dl-ts7990-microtips imx6dl-ts7990-microtips-revb imx6dl-ts7990-okaya imx6dl-ts7990-okaya-revb imx6q-ts4900-14 imx6q-ts4900-2 imx6q-ts4900 imx6q-ts7970 imx6q-ts7990-lxd imx6q-ts7990-lxd-revb imx6q-ts7990-microtips imx6q-ts7990-microtips-revb imx6q-ts7990-okaya imx6q-ts7990-okaya-revb"
CONFIG_DS_KERNEL_INSTALL_UIMAGE_FILESYSTEM=y
CONFIG_DS_KERNEL_INSTALL_UIMAGE_LOADADDR=0x10008000
CONFIG_DS_COMPONENT_LEGACY_BOOTSCRIPT=y
CONFIG_DS_COMPONENT_LEGACY_BOOTSCRIPT_CMDLINE="console=ttymxc0,115200 init=/sbin/init loglevel=4"
CONFIG_DS_COMPONENT_LEGACY_BOOTSCRIPT_INSTALL_SOURCE=y
CONFIG_DS_COMPONENT_TS4900_UTILS=y
CONFIG_DS_COMPONENT_TS4900_FPGA=y
CONFIG_DS_COMPONENT_TSSUPERVISORUPDATE=y
CONFIG_DS_COMPONENT_TS_UBOOT_CONFIGS=y
CONFIG_DS_COMPONENT_WILC3000_FIRMWARE=y
CONFIG_DS_MODULE_WILC3000=y
CONFIG_DS_COMPONENT_WL12XX_FIRMWARE=y
CONFIG_DS_COMPONENT_LINUX_FIRMWARE=y
CONFIG_DS_COMPONENT_LINUX_FIRMWARE_QCA9377=y
CONFIG_DS_WATCHDOG=y
CONFIG_DS_COMPONENT_RESIZE=y
CONFIG_DS_USER_ROOT_EN=y
CONFIG_DS_PURGE_LOCALES=y
CONFIG_DS_HOSTNAME="tsimx6"
CONFIG_DS_TIMEZONE="America/Phoenix"
CONFIG_DS_DOWNGRADE_WPA_HOSTAPD=y
CONFIG_DS_IMAGE_ROOTFS_TAR=y
CONFIG_DS_IMAGE_ROOTFS_TAR_BZIP2=y
```

## configs/tsimx6_ubuntu_22_04_minimal_defconfig
```kconfig
CONFIG_DS_DISTRO_UBUNTU_22_04=y
CONFIG_DS_PACKAGELIST="ubuntu_22.04_minimum.txt"
CONFIG_DS_KERNEL_PROVIDER_GIT_URL="https://github.com/embeddedTS/linux-lts.git"
CONFIG_DS_KERNEL_PROVIDER_GIT_VERSION="v5.10.170.6-ts"
CONFIG_DS_KERNEL_DEFCONFIG="tsimx6_minimal_defconfig"
CONFIG_DS_KERNEL_INSTALL_DEVICETREE_FILESYSTEM="imx6dl-ts4900-14 imx6dl-ts4900-2 imx6dl-ts4900 imx6dl-ts7970 imx6dl-ts7990-lxd imx6dl-ts7990-lxd-revb imx6dl-ts7990-microtips imx6dl-ts7990-microtips-revb imx6dl-ts7990-okaya imx6dl-ts7990-okaya-revb imx6q-ts4900-14 imx6q-ts4900-2 imx6q-ts4900 imx6q-ts7970 imx6q-ts7990-lxd imx6q-ts7990-lxd-revb imx6q-ts7990-microtips imx6q-ts7990-microtips-revb imx6q-ts7990-okaya imx6q-ts7990-okaya-revb"
CONFIG_DS_KERNEL_INSTALL_UIMAGE_FILESYSTEM=y
CONFIG_DS_KERNEL_INSTALL_UIMAGE_LOADADDR=0x10008000
CONFIG_DS_COMPONENT_LEGACY_BOOTSCRIPT=y
CONFIG_DS_COMPONENT_LEGACY_BOOTSCRIPT_CMDLINE="console=ttymxc0,115200 init=/sbin/init loglevel=4"
CONFIG_DS_COMPONENT_TS4900_FPGA=y
CONFIG_DS_COMPONENT_WILC3000_FIRMWARE=y
CONFIG_DS_MODULE_WILC3000=y
CONFIG_DS_COMPONENT_WL12XX_FIRMWARE=y
CONFIG_DS_COMPONENT_LINUX_FIRMWARE=y
CONFIG_DS_COMPONENT_LINUX_FIRMWARE_QCA9377=y
CONFIG_DS_COMPONENT_RESIZE=y
CONFIG_DS_PURGE_LOCALES=y
CONFIG_DS_HOSTNAME="tsimx6"
CONFIG_DS_TIMEZONE="America/Phoenix"
# CONFIG_DS_REGENERATE_SSH_KEYS is not set
# CONFIG_DS_REGENERATE_COMMAND_NOT_FOUND is not set
# CONFIG_DS_USE_NTPSERVER is not set
CONFIG_DS_IMAGE_ROOTFS_TAR=y
CONFIG_DS_IMAGE_ROOTFS_TAR_NONE=y
```

## configs/tsimx6ul_debian_12_headless_defconfig
```kconfig
CONFIG_DS_DISTRO_DEBIAN_12=y
CONFIG_DS_PACKAGELIST="debian_12_headless.txt"
CONFIG_DS_KERNEL_PROVIDER_GIT_URL="https://github.com/embeddedTS/linux-lts.git"
CONFIG_DS_KERNEL_PROVIDER_GIT_VERSION="v5.10.208-ts"
CONFIG_DS_KERNEL_DEFCONFIG="tsimx6ul_defconfig"
CONFIG_DS_KERNEL_INSTALL_DEVICETREE_FILESYSTEM="imx6ul-ts7250v3 imx6ul-ts7250v3-reva imx6ul-ts7100-1 imx6ul-ts7100-3"
CONFIG_DS_KERNEL_INSTALL_ZIMAGE_FILESYSTEM=y
CONFIG_DS_COMPONENT_TS7100_UTILS=y
CONFIG_DS_COMPONENT_TSSUPERVISORUPDATE=y
CONFIG_DS_COMPONENT_TS_UBOOT_CONFIGS=y
CONFIG_DS_COMPONENT_WILC3000_FIRMWARE=y
CONFIG_DS_MODULE_WILC3000=y
CONFIG_DS_COMPONENT_DISTROBOOT_SCRIPTS=y
CONFIG_DS_COMPONENT_DISTROBOOT_SCRIPTS_INSTALL_SOURCE=y
CONFIG_DS_WATCHDOG=y
CONFIG_DS_COMPONENT_RESIZE=y
CONFIG_DS_USER_ROOT_EN=y
CONFIG_DS_PURGE_LOCALES=y
CONFIG_DS_HOSTNAME="tsimx6ul"
CONFIG_DS_TIMEZONE="America/Phoenix"
CONFIG_DS_IMAGE_ROOTFS_TAR=y
```

## configs/tsimx6ul_debian_12_minimal_defconfig
```kconfig
CONFIG_DS_DISTRO_DEBIAN_12=y
CONFIG_DS_PACKAGELIST="debian_12_minimum.txt"
CONFIG_DS_KERNEL_PROVIDER_GIT_URL="https://github.com/embeddedTS/linux-lts.git"
CONFIG_DS_KERNEL_PROVIDER_GIT_VERSION="v5.10.206.1-ts"
CONFIG_DS_KERNEL_DEFCONFIG="tsimx6ul_minimal_defconfig"
CONFIG_DS_KERNEL_INSTALL_DEVICETREE_FILESYSTEM="imx6ul-ts7250v3 imx6ul-ts7250v3-reva imx6ul-ts7100-1 imx6ul-ts7100-3"
CONFIG_DS_KERNEL_INSTALL_ZIMAGE_FILESYSTEM=y
CONFIG_DS_COMPONENT_WILC3000_FIRMWARE=y
CONFIG_DS_MODULE_WILC3000=y
CONFIG_DS_COMPONENT_DISTROBOOT_SCRIPTS=y
CONFIG_DS_WATCHDOG=y
CONFIG_DS_COMPONENT_RESIZE=y
CONFIG_DS_USER_ROOT_EN=y
CONFIG_DS_PURGE_LOCALES=y
CONFIG_DS_HOSTNAME="tsimx6ul"
# CONFIG_DS_REGENERATE_SSH_KEYS is not set
# CONFIG_DS_REGENERATE_COMMAND_NOT_FOUND is not set
# CONFIG_DS_USE_NTPSERVER is not set
CONFIG_DS_IMAGE_ROOTFS_TAR=y
```
